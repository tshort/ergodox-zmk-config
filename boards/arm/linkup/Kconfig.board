## boards/arm/linkup/Kconfig.board
```kconfig
# Jiran BLE Lite board configuration

# Copyright (c) 2021 The ZMK Contributors
# SPDX-License-Identifier: MIT

config BOARD_LINKUP_LEFT
	bool "Link-Up ortho left"
	depends on SOC_NRF52840_QIAA

config BOARD_LINKUP_RIGHT
	bool "Link-Up ortho right"
	depends on SOC_NRF52840_QIAA

config BOARD_LINKUP_X
	bool "Link-Up ortho X"
	depends on SOC_NRF52840_QIAA
```

## boards/arm/linkup/Kconfig.defconfig
```kconfig
if BOARD_LINKUP_LEFT || BOARD_LINKUP_RIGHT || BOARD_LINKUP_X

config BOARD
	default "Link-Up Ortho"

config BT_CTLR
	default BT

endif # BOARD_LINKUP_LEFT || BOARD_LINKUP_RIGHT || BOARD_LINKUP_X
```

## config/Kconfig.defconfig
```kconfig
if SHIELD_LINKUP_DONGLE || SHIELD_LINKUP_LEFTCENTRAL || SHIELD_LINKUP_LEFTSINGLE || SHIELD_LINKUP_RIGHTCENTRAL || SHIELD_LINKUP_RIGHTSINGLE

config ZMK_BLE
	default y

config ZMK_USB
	default y

config ZMK_KEYBOARD_NAME
	default "Link-Up Boards"

endif

if SHIELD_LINKUP_DONGLE || SHIELD_LINKUP_LEFTCENTRAL || SHIELD_LINKUP_RIGHTCENTRAL

config ZMK_SPLIT
	default y

config ZMK_SPLIT_ROLE_CENTRAL
	default y

endif
```

## config/boards/arm/linkup/Kconfig.board
```kconfig
# Jiran BLE Lite board configuration

# Copyright (c) 2021 The ZMK Contributors
# SPDX-License-Identifier: MIT

config BOARD_LINKUP
	bool "LinkUp"
	depends on SOC_NRF52840_QIAA
```

## config/boards/shields/linkup/Kconfig.defconfig
```kconfig
if SHIELD_LINKUP_DONGLE || SHIELD_LINKUP_LEFTCENTRAL || SHIELD_LINKUP_LEFT || SHIELD_LINKUP_RIGHTCENTRAL || SHIELD_LINKUP_RIGHT || SHIELD_LINKUP_XTRACENTRAL || SHIELD_LINKUP_XTRA

config ZMK_BLE
	default y

config ZMK_SPLIT
	default y

config ZMK_KEYBOARD_NAME
	default "Link-Up Board"

endif

if SHIELD_LINKUP_DONGLE || SHIELD_LINKUP_LEFTCENTRAL || SHIELD_LINKUP_RIGHTCENTRAL || SHIELD_LINKUP_XTRACENTRAL

config ZMK_SPLIT_ROLE_CENTRAL
	default y

endif

if SHIELD_LINKUP_DONGLE 

config ZMK_USB
	default y

endif
```

## config/boards/shields/linkup/Kconfig.shield
```kconfig
config SHIELD_LINKUP_DONGLE
	def_bool $(shields_list_contains,linkup_dongle)

config SHIELD_LINKUP_LEFTCENTRAL
	def_bool $(shields_list_contains,linkup_leftcentral)

config SHIELD_LINKUP_RIGHTCENTRAL
	def_bool $(shields_list_contains,linkup_rightcentral)

config SHIELD_LINKUP_XTRACENTRAL
	def_bool $(shields_list_contains,linkup_rightcentral)

config SHIELD_LINKUP_LEFT
	def_bool $(shields_list_contains,linkup_left)

config SHIELD_LINKUP_RIGHT
	def_bool $(shields_list_contains,linkup_right)

config SHIELD_LINKUP_XTRA
	def_bool $(shields_list_contains,linkup_xtra)
	
config SHIELD_LINKUP_TEST
	def_bool $(shields_list_contains,linkup_test)
```
